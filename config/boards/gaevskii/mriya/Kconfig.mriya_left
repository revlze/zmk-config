## config/boards/gaevskii/mriya/board.yml
```yaml
boards:
  - name: mriya_left
    vendor: gaevskii
    socs:
      - name: nrf52840
        variants:
          - name: zmk
  - name: mriya_right
    vendor: gaevskii
    socs:
      - name: nrf52840
        variants:
          - name: zmk
```
